# psoc6_02 register map
Vendor: Infineon Technologies; Series: PSOC6_02; File version: 1.0
CPU: CM4 r0p1, little endian, MPU, FPU, VTOR, 3 interrupt priority bits
Registers are 32-bit, read-write, reset 0x0 unless marked. A register's access mark holds for its fields unless they carry their own. Offsets are from the block's base; lines under a group give offsets from that group; [hi:lo] are bit positions; {n}, {i} and the like mark numbered series; 'fields as' and 'values as' point back to an identical list; <NAME> marks a mode.

## Memory map
0x40000000 PERI size 0x10000 — Peripheral interconnect
0x40010000 PERI_MS size 0x10000 — Peripheral interconnect, master interface
0x40100000 CRYPTO size 0x10000 — Cryptography component
0x40200000 CPUSS size 0x10000 — CPU subsystem (CPUSS)
0x40210000 FAULT size 0x10000 — Fault structures
0x40220000 IPC size 0x10000
0x40230000 PROT size 0x10000 — Protection
0x40240000 FLASHC size 0x10000 — Flash controller
0x40260000 SRSS size 0x10000 — SRSS Core Registers
0x40270000 BACKUP size 0x10000 — SRSS Backup Domain
0x40280000 DW0 size 0x10000 — Datawire Controller
0x40290000 DW1 size 0x10000
0x402A0000 DMAC size 0x10000
0x402C0000 EFUSE size 0x80 — EFUSE MXS40 registers
0x402D0000 PROFILE size 0x10000 — Energy Profiler IP
0x40300000 HSIOM size 0x4000 — High Speed IO Matrix (HSIOM)
0x40310000 GPIO size 0x10000 — GPIO port control/configuration
0x40320000 SMARTIO size 0x10000 — Programmable IO configuration
0x40350000 LPCOMP size 0x10000 — Low Power Comparators
0x40360000 CSD0 size 0x1000 — Capsense Controller
0x40380000 TCPWM0 size 0x10000 — Timer/Counter/PWM
0x40390000 TCPWM1 size 0x10000
0x403B0000 LCD0 size 0x10000 — LCD Controller Block
0x403F0000 USBFS0 size 0x10000 — USB Host and Device Controller
0x40420000 SMIF0 size 0x10000 — Serial Memory Interface
0x40460000 SDHC0 size 0x10000 — SD/eMMC Host Controller
0x40470000 SDHC1 size 0x10000
0x40600000 SCB0 size 0x10000 — Serial Communications Block (SPI/UART/I2C)
{0x40600000+0x10000*n} SCB{n} size 0x10000 (n=1..12)
0x409D0000 SAR size 0x10000 — SAR ADC with Sequencer
0x409F0000 PASS size 0x10000 — PASS top-level MMIO (DSABv2, INTR)
0x40A00000 PDM0 size 0x1000 — PDM registers
0x40A10000 I2S0 size 0x1000 — I2S registers
0x40A11000 I2S1 size 0x1000

## Interrupts
{n} ioss_interrupts_gpio_{n} (CPUSS) (n=0..14) — GPIO Port Interrupt #{n}
15 ioss_interrupt_gpio (CPUSS) — GPIO All Ports
16 ioss_interrupt_vdd (CPUSS) — GPIO Supply Detect Interrupt
17 lpcomp_interrupt (CPUSS) — Low Power Comparator Interrupt
18 scb_8_interrupt (CPUSS) — Serial Communication Block #8 (DeepSleep capable)
19 srss_interrupt_mcwdt_0 (CPUSS) — Multi Counter Watchdog Timer interrupt
20 srss_interrupt_mcwdt_1 (CPUSS) — Multi Counter Watchdog Timer interrupt
21 srss_interrupt_backup (CPUSS) — Backup domain interrupt
22 srss_interrupt (CPUSS) — Other combined Interrupts for SRSS (LVD, WDT, CLKCAL)
{n+23} cpuss_interrupts_ipc_{n} (CPUSS) (n=0..15) — CPUSS Inter Process Communication Interrupt #{n}
{n+39} scb_{n}_interrupt (CPUSS) (n=0..7) — Serial Communication Block #{n}
47 scb_9_interrupt (CPUSS) — Serial Communication Block #9
48 scb_10_interrupt (CPUSS) — Serial Communication Block #10
49 scb_11_interrupt (CPUSS) — Serial Communication Block #11
50 scb_12_interrupt (CPUSS) — Serial Communication Block #12
51 csd_interrupt (CPUSS) — CSD (Capsense) interrupt
52 cpuss_interrupts_dmac_0 (CPUSS) — CPUSS DMAC, Channel #0
53 cpuss_interrupts_dmac_1 (CPUSS) — CPUSS DMAC, Channel #1
54 cpuss_interrupts_dmac_2 (CPUSS) — CPUSS DMAC, Channel #2
55 cpuss_interrupts_dmac_3 (CPUSS) — CPUSS DMAC, Channel #3
{n+56} cpuss_interrupts_dw0_{n} (CPUSS) (n=0..28) — CPUSS DataWire #0, Channel #{n}
{n+85} cpuss_interrupts_dw1_{n} (CPUSS) (n=0..28) — CPUSS DataWire #1, Channel #{n}
114 cpuss_interrupts_fault_0 (CPUSS) — CPUSS Fault Structure Interrupt #0
115 cpuss_interrupts_fault_1 (CPUSS) — CPUSS Fault Structure Interrupt #1
116 cpuss_interrupt_crypto (CPUSS) — CRYPTO Accelerator Interrupt
117 cpuss_interrupt_fm (CPUSS) — FLASH Macro Interrupt
118 cpuss_interrupts_cm4_fp (CPUSS) — Floating Point operation fault
119 cpuss_interrupts_cm0_cti_0 (CPUSS) — CM0+ CTI #0
120 cpuss_interrupts_cm0_cti_1 (CPUSS) — CM0+ CTI #1
121 cpuss_interrupts_cm4_cti_0 (CPUSS) — CM4 CTI #0
122 cpuss_interrupts_cm4_cti_1 (CPUSS) — CM4 CTI #1
{n+123} tcpwm_0_interrupts_{n} (CPUSS) (n=0..7) — TCPWM #0, Counter #{n}
{n+131} tcpwm_1_interrupts_{n} (CPUSS) (n=0..23) — TCPWM #1, Counter #{n}
155 pass_interrupt_sar (CPUSS) — SAR ADC interrupt
156 audioss_0_interrupt_i2s (CPUSS) — I2S0 Audio interrupt
157 audioss_0_interrupt_pdm (CPUSS) — PDM0/PCM0 Audio interrupt
158 audioss_1_interrupt_i2s (CPUSS) — I2S1 Audio interrupt
159 profile_interrupt (CPUSS) — Energy Profiler interrupt
160 smif_interrupt (CPUSS) — Serial Memory Interface interrupt
161 usb_interrupt_hi (CPUSS) — USB Interrupt
162 usb_interrupt_med (CPUSS) — USB Interrupt
163 usb_interrupt_lo (CPUSS) — USB Interrupt
164 sdhc_0_interrupt_wakeup (CPUSS) — SDIO wakeup interrupt for mxsdhc
165 sdhc_0_interrupt_general (CPUSS) — Consolidated interrupt for mxsdhc for everything else
166 sdhc_1_interrupt_wakeup (CPUSS) — EEMC wakeup interrupt for mxsdhc, not used
167 sdhc_1_interrupt_general (CPUSS) — Consolidated interrupt for mxsdhc for everything else

## Licence text in the file
(c) (2016-2026), Infineon Technologies AG or an affiliate of Infineon Technologies AG. . SPDX-License-Identifier: Apache-2.0 . Licensed under the Apache License, Version 2.0 (the "License"); you may not use this file except in compliance with the License. You may obtain a copy of the License at http://www.apache.org/licenses/LICENSE-2.0 . Unless required by applicable law or agreed to in writing, software distributed under the License is distributed on an "AS IS" BASIS, WITHOUT WARRANTIES OR CONDITIONS OF ANY KIND, either express or implied. See the License for the specific language governing permissions and limitations under the License.
